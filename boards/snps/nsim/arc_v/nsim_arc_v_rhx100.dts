/dts-v1/;

#include "rhx100.dtsi"

/ {
	model = "Synopsys RHX100";
	compatible = "snps,rhx100";

	chosen {
		zephyr,flash = &ddr0;
		zephyr,sram = &dccm0;
		//zephyr,console = &uart0;
		//zephyr,shell-uart = &uart0;
	};
};
