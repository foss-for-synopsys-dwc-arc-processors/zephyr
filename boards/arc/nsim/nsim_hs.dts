/*
 * Copyright (c) 2019, Synopsys, Inc. All rights reserved.
 *
 * SPDX-License-Identifier: Apache-2.0
 */

/dts-v1/;

#include <zephyr/dt-bindings/memory-attr/memory-attr-sw.h>

#include "nsim.dtsi"
#include "nsim-ccm-mem.dtsi"
#include "nsim-uart-ns16550.dtsi"

/ {
	model = "snps,nsim_hs";
	compatible = "snps,nsim_hs";

	cpus {
		#address-cells = <1>;
		#size-cells = <0>;

		cpu@0 {
			device_type = "cpu";
			compatible = "snps,archs";
			reg = <0>;
		};
	};

	mem_noncache_sw: memory@20000A000 {
		compatible = "zephyr,memory-region", "mmio-sram";
		reg = <0x2000A000 0x1000>;
		zephyr,memory-region = "MEM_NON_CACHEABLE_SW";
		zephyr,memory-attr = <( DT_MEM_SW_ALLOC_NON_CACHE )>;
	};
};
