## CMakeLists.txt
```
# Copyright (c) 2022 Synopsys
# SPDX-License-Identifier: Apache-2.0

cmake_minimum_required(VERSION 3.20.0)
find_package(Zephyr REQUIRED HINTS $ENV{ZEPHYR_BASE})
project(dsp_sharing)

target_sources(app PRIVATE
    src/main.c
    src/load_store.c
    )

if(CONFIG_ISA_ARCV2)
zephyr_include_directories(
      ${ARCMWDT_TOOLCHAIN_PATH}/MetaWare/arc/lib/src/fx/include/
    )
target_sources(app PRIVATE src/calculation_arc.c)
endif()
```

## prj.conf
```kconfig
CONFIG_ZTEST=y
CONFIG_DSP=y
CONFIG_DSP_SHARING=y
CONFIG_MAIN_STACK_SIZE=1024
CONFIG_ARC_DSP_BFLY_SHARING=y
```

## src/main.c
```c
/*
 * Copyright (c) 2022 Synopsys
 *
 * SPDX-License-Identifier: Apache-2.0
 */

#include <ztest.h>
#include "test_common.h"

#ifndef CONFIG_DSP
#error Rebuild with the DSP config option enabled
#endif

#ifndef CONFIG_DSP_SHARING
#error Rebuild with the DSP_SHARING config option enabled
#endif

extern void test_load_store(void);
/* test_calculation is arch specific */
extern void test_calculation(void);

void test_main(void)
{
	/*
	 * Enable round robin scheduling to allow both the low priority complex
	 * computation and load/store tasks to execute. The high priority complex
	 * computation and load/store tasks will preempt the low priority tasks
	 * periodically.
	 */
	k_sched_time_slice_set(10, THREAD_LOW_PRIORITY);

	/* Run the testsuite */
	ztest_test_suite(dsp_sharing,
			 ztest_unit_test(test_load_store),
			 ztest_unit_test(test_calculation));
	ztest_run_test_suite(dsp_sharing);
}
```

## src/calculation_arc.c
```c
/*
 * Copyright (c) 2022 Synopsys
 *
 * SPDX-License-Identifier: Apache-2.0
 */

/*
 * @file
 * @brief complex number multiplication portion of DSP sharing test
 *
 * @ingroup kernel_dspsharing_tests
 *
 * This module is used for the DSP sharing test, and supplements the basic
 * load/store test by incorporating two additional threads that utilize the
 * DSP unit.
 *
 * Testing utilizes a pair of tasks that independently compute complex vector
 * dot product. The lower priority task is regularly preempted by the higher
 * priority task, thereby testing whether DSP context information is properly
 * preserved.
 *
 * A reference value of computed result is computed once at the start of the
 * test. All subsequent computations must produce the same value, otherwise
 * an error has occurred.
 */

#include <ztest.h>
#include "fxarc.h"
#include "dsp_context.h"
#include "test_common.h"

/* stored in XY memory, need AGU_SHARING */
#define DATA_ATTR __xy __attribute__((section(".Xdata")))
static DATA_ATTR const cq15_t cq15_a[3] = {{0x20, 10}, {0x10, 20}, {4, 30}};
static DATA_ATTR const cq15_t cq15_b[3] = {{0x20, 11}, {0x10, 21}, {5, 31}};

static volatile short reference_result;

static volatile unsigned int calc_low_count;
static volatile unsigned int calc_high_count;

/* Indicates that the load/store test exited */
static volatile bool test_exited;

/* Semaphore for signaling end of test */
static K_SEM_DEFINE(test_exit_sem, 0, 1);

/**
 * @brief Entry point for the low priority compute task
 *
 * @ingroup kernel_dspsharing_tests
 */
static void calculate_low(void)
{
	volatile short res[2];
	/* Loop until the test finishes, or an error is detected. */
	for (calc_low_count = 0; !test_exited; calc_low_count++) {

		v2accum32_t acc = {0, 0};

		for (int i = 0; i < 3; i++) {
			acc = fx_v2a32_cmac_cq15(acc, cq15_a[i], cq15_b[i]);
		}
		/* cast reult from v2accum32_ to short type */
		res[0] = fx_q15_cast_asl_rnd_a32(fx_get_v2a32(acc, 0), 15);
		res[1] = fx_q15_cast_asl_rnd_a32(fx_get_v2a32(acc, 1), 15);

		if (reference_result == 0) {
			reference_result = res[0];
		} else if (reference_result != res[0]) {
			printf("Computed result %d, reference result %d\n",
			       res[0], reference_result);
		}

		zassert_equal(reference_result, res[0],
			      "complex product computation error");
	}
}

/**
 * @brief Entry point for the high priority compute task
 *
 * @ingroup kernel_dspsharing_tests
 */
static void calculate_high(void)
{
	volatile short res[2];
	/* Run the test until the specified maximum test count is reached */
	for (calc_high_count = 0; calc_high_count <= MAX_TESTS;
	     calc_high_count++) {

		v2accum32_t acc = {0, 0};

		for (int i = 0; i < 3; i++) {
			acc = fx_v2a32_cmac_cq15(acc, cq15_a[i], cq15_b[i]);
		}

		/*
		 * Relinquish the processor for the remainder of the current
		 * system clock tick, so that lower priority threads get a
		 * chance to run.
		 *
		 * This exercises the ability of the kernel to restore the
		 * DSP state of a low priority thread _and_ the ability of the
		 * kernel to provide a "clean" DSP state to this thread
		 * once the sleep ends.
		 */
		k_sleep(K_MSEC(10));

		res[0] = fx_q15_cast_asl_rnd_a32(fx_get_v2a32(acc, 0), 15);
		res[1] = fx_q15_cast_asl_rnd_a32(fx_get_v2a32(acc, 1), 15);

		if (reference_result == 0) {
			reference_result = res[0];
		} else if (reference_result != res[0]) {
			printf("Computed result %d, reference result %d\n",
			       res[0], reference_result);
		}

		zassert_equal(reference_result, res[0],
			      "complex product computation error");

		/* Periodically issue progress report */
		if ((calc_high_count % 100) == 50) {
			printf("complex product calculation OK after %u (high) "
			       "+"
			       " %u (low) tests (computed %d)\n",
			       calc_high_count, calc_low_count, res[0]);
		}
	}

	/* Signal end of test */
	test_exited = true;
	k_sem_give(&test_exit_sem);
}

K_THREAD_DEFINE(cal_low, THREAD_STACK_SIZE, calculate_low, NULL, NULL, NULL,
		THREAD_LOW_PRIORITY, K_DSP_REGS | K_AGU_REGS, K_TICKS_FOREVER);

K_THREAD_DEFINE(cal_high, THREAD_STACK_SIZE, calculate_high, NULL, NULL, NULL,
		THREAD_HIGH_PRIORITY, K_DSP_REGS | K_AGU_REGS, K_TICKS_FOREVER);

void test_calculation(void)
{
	/* Initialise test states */
	test_exited = false;
	k_sem_reset(&test_exit_sem);

	/* Start test threads */
	k_thread_start(cal_low);
	k_thread_start(cal_high);

	/* Wait for test threads to exit */
	k_sem_take(&test_exit_sem, K_FOREVER);
}
```

## src/dsp_context.h
```c
/**
 * @file
 * @brief common definitions for the DSP sharing test application
 */

/*
 * Copyright (c) 2022 Synopsys
 *
 * SPDX-License-Identifier: Apache-2.0
 */

#ifndef _DSPCONTEXT_H
#define _DSPCONTEXT_H

/*
 * Each architecture must define the following structures (which may be empty):
 *      'struct dsp_volatile_register_set'
 *      'struct dsp_non_volatile_register_set'
 *
 * Each architecture must also define the following macros:
 *      SIZEOF_DSP_VOLATILE_REGISTER_SET
 *      SIZEOF_DSP_NON_VOLATILE_REGISTER_SET
 * Those macros are used as sizeof(<an empty structure>) is compiler specific;
 * that is, it may evaluate to a non-zero value.
 *
 * Each architecture shall also have custom implementations of:
 *     _load_all_dsp_registers()
 *     _load_then_store_all_dsp_registers()
 *     _store_all_dsp_registers()
 */

#if defined(CONFIG_ISA_ARCV2)

struct dsp_volatile_register_set {
#ifdef CONFIG_ARC_DSP_BFLY_SHARING
	uintptr_t dsp_bfly0;
	uintptr_t agu_ap0;
	uintptr_t agu_os0;
#endif
};

struct dsp_non_volatile_register_set {
	/* No non-volatile dsp registers */
};

#define SIZEOF_DSP_VOLATILE_REGISTER_SET sizeof(struct dsp_volatile_register_set)
#define SIZEOF_DSP_NON_VOLATILE_REGISTER_SET 0

#else

#error  "Architecture must provide the following definitions:\n"
"\t'struct dsp_volatile_registers'\n"
"\t'struct dsp_non_volatile_registers'\n"
"\t'SIZEOF_DSP_VOLATILE_REGISTER_SET'\n"
"\t'SIZEOF_DSP_NON_VOLATILE_REGISTER_SET'\n"
#endif /* CONFIG_ISA_ARCV2 */

/* the set of ALL dsp registers */

struct dsp_register_set {
	struct dsp_volatile_register_set dsp_volatile;
	struct dsp_non_volatile_register_set dsp_non_volatile;
};

#define SIZEOF_DSP_REGISTER_SET \
	(SIZEOF_DSP_VOLATILE_REGISTER_SET + SIZEOF_DSP_NON_VOLATILE_REGISTER_SET)

/*
 * The following constants define the initial byte value used by the background
 * task, and the thread when loading up the dsp registers.
 */

#define MAIN_DSP_REG_CHECK_BYTE ((unsigned char)0xe5)
#define FIBER_DSP_REG_CHECK_BYTE ((unsigned char)0xf9)

#endif /* _DSPCONTEXT_H */
```

## src/dsp_regs_arc.h
```c
/**
 * @file
 * @brief ARC specific dsp register macros
 */

/*
 * Copyright (c) 2022, Synopsys.
 *
 * SPDX-License-Identifier: Apache-2.0
 */

#ifndef _DSP_REGS_ARC_H
#define _DSP_REGS_ARC_H

#include <zephyr/toolchain.h>
#include "dsp_context.h"

/**
 *
 * @brief Load all dsp registers
 *
 * This function loads all DSP and AGU registers pointed to by @a regs.
 * It is expected that a subsequent call to _store_all_dsp_registers()
 * will be issued to dump the dsp registers to memory.
 *
 * The format/organization of 'struct dsp_register_set'; the generic C test
 * code (main.c) merely treat the register set as an array of bytes.
 *
 * The only requirement is that the arch specific implementations of
 * _load_all_dsp_registers() and _store_all_dsp_registers() agree
 * on the format.
 *
 */
static inline void _load_all_dsp_registers(struct dsp_register_set *regs)
{
	uint32_t temp = 0;

	__asm__ volatile (
		"ld %1, [%0, 0];\n\t"
		"sr %1, [%2];\n\t"
		"ld %1, [%0, 4];\n\t"
		"sr %1, [%3];\n\t"
		"ld %1, [%0, 8];\n\t"
		"sr %1, [%4];\n\t"
		: : "r" (regs), "r" (temp),
		"i"(_ARC_V2_DSP_BFLY0), "i"(_ARC_V2_AGU_AP0),
		"i"(_ARC_V2_AGU_OS0)
		: "memory"
		);
}

/**
 *
 * @brief Dump all dsp registers to memory
 *
 * This function stores all DSP and AGU registers to the memory buffer
 * specified by @a regs. It is expected that a previous invocation of
 * _load_all_dsp_registers() occurred to load all the dsp
 * registers from a memory buffer.
 *
 */

static inline void _store_all_dsp_registers(struct dsp_register_set *regs)
{
	uint32_t temp = 0;

	__asm__ volatile (
		"lr %1, [%2];\n\t"
		"st %1, [%0, 0];\n\t"
		"lr %1, [%3];\n\t"
		"st %1, [%0, 4];\n\t"
		"lr %1, [%4];\n\t"
		"st %1, [%0, 8];\n\t"
		: : "r" (regs), "r" (temp),
		"i"(_ARC_V2_DSP_BFLY0), "i"(_ARC_V2_AGU_AP0),
		"i"(_ARC_V2_AGU_OS0)
		);
}

/**
 *
 * @brief Load then dump all dsp registers to memory
 *
 * This function loads all DSP and AGU registers from the memory buffer
 * specified by @a regs, and then stores them back to that buffer.
 *
 * This routine is called by a high priority thread prior to calling a primitive
 * that pends and triggers a co-operative context switch to a low priority
 * thread.
 *
 */

static inline void _load_then_store_all_dsp_registers(struct dsp_register_set
							*regs)
{
	_load_all_dsp_registers(regs);
	_store_all_dsp_registers(regs);
}
#endif /* _DSP_REGS_ARC_H */
```

## src/load_store.c
```c
/*
 * Copyright (c) 2022, Synopsys.
 *
 * SPDX-License-Identifier: Apache-2.0
 */

/*
 * @file
 * @brief load/store portion of DSP sharing test
 *
 * @defgroup kernel_dspsharing_tests DSP Sharing Tests
 *
 * @ingroup all_tests
 *
 * This module implements the load/store portion of the  DSP sharing test. This
 * version of this test utilizes a pair of tasks.
 *
 * The load/store test validates the dsp unit context
 * save/restore mechanism. This test utilizes a pair of threads of different
 * priorities that each use the dsp registers. The context
 * switching that occurs exercises the kernel's ability to properly preserve
 * the dsp registers. The test also exercises the kernel's ability
 * to automatically enable dsp support for a task, if supported.
 *
 */

#include <ztest.h>
#include <zephyr/debug/gcov.h>

#if defined(CONFIG_ISA_ARCV2)
#include "dsp_regs_arc.h"
#endif

#include "dsp_context.h"
#include "test_common.h"

/* space for dsp register load/store area used by low priority task */
static struct dsp_register_set dsp_reg_set_load;
static struct dsp_register_set dsp_reg_set_store;

/* space for dsp register load/store area used by high priority thread */
static struct dsp_register_set dsp_reg_set;

static volatile unsigned int load_store_low_count;
static volatile unsigned int load_store_high_count;

/* Indicates that the load/store test exited */
static volatile bool test_exited;

/* Semaphore for signaling end of test */
static K_SEM_DEFINE(test_exit_sem, 0, 1);

/**
 * @brief Low priority DSP load/store thread
 *
 * @ingroup kernel_dspsharing_tests
 *
 * @see k_sched_time_slice_set(), memset(),
 * _load_all_dsp_registers(), _store_all_dsp_registers()
 */
static void load_store_low(void)
{
	volatile unsigned int i;
	bool error = false;
	unsigned char init_byte;
	unsigned char *store_ptr = (unsigned char *)&dsp_reg_set_store;
	unsigned char *load_ptr = (unsigned char *)&dsp_reg_set_load;
	/*
	 * Initialize dsp load buffer to known values;
	 * these values must be different than the value used in other threads.
	 */
	init_byte = MAIN_DSP_REG_CHECK_BYTE;
	for (i = 0; i < SIZEOF_DSP_REGISTER_SET; i++) {
		load_ptr[i] = init_byte++;
	}

	/* Loop until the test finishes, or an error is detected. */
	for (load_store_low_count = 0; !test_exited; load_store_low_count++) {

		/*
		 * Clear store buffer to erase all traces of any previous
		 * dsp values that have been saved.
		 */
		(void)memset(&dsp_reg_set_store, 0, SIZEOF_DSP_REGISTER_SET);

		/*
		 * Utilize an architecture specific function to load all the
		 * dsp registers with known values.
		 */
		_load_all_dsp_registers(&dsp_reg_set_load);

		/*
		 * Waste some cycles to give the high priority load/store
		 * thread an opportunity to run when the low priority thread is
		 * using the dsp registers.
		 *
		 * IMPORTANT: This logic requires that sys_clock_tick_get_32() not
		 * perform any dsp operations!
		 */
		k_busy_wait(100);

		/*
		 * Utilize an architecture specific function to dump the
		 * contents of all dsp registers to memory.
		 */
		_store_all_dsp_registers(&dsp_reg_set_store);
		/*
		 * Compare each byte of buffer to ensure the expected value is
		 * present, indicating that the dsp registers weren't
		 * impacted by the operation of the high priority thread(s).
		 *
		 * Display error message and terminate if discrepancies are
		 * detected.
		 */
		init_byte = MAIN_DSP_REG_CHECK_BYTE;

		for (i = 0; i < SIZEOF_DSP_REGISTER_SET; i++) {
			if (store_ptr[i] != init_byte) {
				TC_ERROR("Found 0x%x instead of 0x%x @ "
					 "offset 0x%x\n",
					 store_ptr[i],
					 init_byte, i);
				TC_ERROR("Discrepancy found during "
					 "iteration %d\n",
					 load_store_low_count);
				error = true;
			}
			init_byte++;
		}

		/* Terminate if a test error has been reported */
		zassert_false(error, NULL);
	}
}

/**
 * @brief High priority DSP load/store thread
 *
 * @ingroup kernel_dspsharing_tests
 *
 * @see _load_then_store_all_dsp_registers()
 */
static void load_store_high(void)
{
	volatile unsigned int i;
	unsigned char init_byte;
	unsigned char *reg_set_ptr = (unsigned char *)&dsp_reg_set;

	/* Run the test until the specified maximum test count is reached */
	for (load_store_high_count = 0;
	     load_store_high_count <= MAX_TESTS;
	     load_store_high_count++) {

		/*
		 * Initialize the dsp_reg_set structure by treating it as
		 * a simple array of bytes (the arrangement and actual number
		 * of registers is not important for this generic C code).  The
		 * structure is initialized by using the byte value specified
		 * by the constant FIBER_DSP_REG_CHECK_BYTE, and then
		 * incrementing the value for each successive location in the
		 * dsp_reg_set structure.
		 *
		 * The initial byte value, and thus the contents of the entire
		 * dsp_reg_set structure, must be different for each
		 * thread to effectively test the kernel's ability to
		 * properly save/restore the dsp-processed values during a
		 * context switch.
		 */
		init_byte = FIBER_DSP_REG_CHECK_BYTE;

		for (i = 0; i < SIZEOF_DSP_REGISTER_SET; i++) {
			reg_set_ptr[i] = init_byte++;
		}

		/*
		 * Utilize an architecture specific function to load all the
		 * dsp registers with the contents of the
		 * dsp_reg_set structure.
		 *
		 * The goal of the loading all dsp registers with
		 * values that differ from the values used in other threads is
		 * to help determine whether the dsp register
		 * save/restore mechanism in the kernel's context switcher
		 * is operating correctly.
		 *
		 * When a subsequent k_timer_test() invocation is
		 * performed, a (cooperative) context switch back to the
		 * preempted task will occur. This context switch should result
		 * in restoring the state of the task's dsp
		 * registers when the task was swapped out due to the
		 * occurrence of the timer tick.
		 */
		_load_then_store_all_dsp_registers(&dsp_reg_set);

		/*
		 * Relinquish the processor for the remainder of the current
		 * system clock tick, so that lower priority threads get a
		 * chance to run.
		 *
		 * This exercises the ability of the kernel to restore the
		 * DSP state of a low priority thread _and_ the ability of the
		 * kernel to provide a "clean" DSP state to this thread
		 * once the sleep ends.
		 */
		k_sleep(K_MSEC(1));

		/* Periodically issue progress report */
		if ((load_store_high_count % 100) == 0) {
			PRINT_DATA("Load and store OK after %u (high) "
				   "+ %u (low) tests\n",
				   load_store_high_count,
				   load_store_low_count);
		}
	}

	/* Signal end of test */
	test_exited = true;
	k_sem_give(&test_exit_sem);
}

K_THREAD_DEFINE(load_low, THREAD_STACK_SIZE, load_store_low, NULL, NULL, NULL,
		THREAD_LOW_PRIORITY, THREAD_DSP_FLAGS, K_TICKS_FOREVER);

K_THREAD_DEFINE(load_high, THREAD_STACK_SIZE, load_store_high, NULL, NULL, NULL,
		THREAD_HIGH_PRIORITY, THREAD_DSP_FLAGS, K_TICKS_FOREVER);

void test_load_store(void)
{
	/* Initialise test states */
	test_exited = false;
	k_sem_reset(&test_exit_sem);

	/* Start test threads */
	k_thread_start(load_low);
	k_thread_start(load_high);

	/* Wait for test threads to exit */
	k_sem_take(&test_exit_sem, K_FOREVER);
}
```

## src/test_common.h
```c
/*
 * Copyright (c) 2022 Synopsys
 *
 * SPDX-License-Identifier: Apache-2.0
 */

#define MAX_TESTS	500

/*
 * Test Thread Parameters
 */
#define THREAD_STACK_SIZE	(1024 + CONFIG_TEST_EXTRA_STACK_SIZE)

#define THREAD_HIGH_PRIORITY	5
#define THREAD_LOW_PRIORITY	10

#if defined(CONFIG_ISA_ARCV2)
#define THREAD_DSP_FLAGS		(K_DSP_REGS | K_AGU_REGS)
#else
#define THREAD_DSP_FLAGS		(K_DSP_REGS)
#endif
```
