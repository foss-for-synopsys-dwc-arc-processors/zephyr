## CMakeLists.txt
```
# SPDX-License-Identifier: Apache-2.0

cmake_minimum_required(VERSION 3.13.1)

include($ENV{ZEPHYR_BASE}/cmake/app/boilerplate.cmake NO_POLICY_SCOPE)
project(embarc_mli)

FILE(GLOB app_sources src/*.c)
target_sources(app PRIVATE ${app_sources})
```

## prj.conf
```kconfig
CONFIG_EMBARC_MLI=y
CONFIG_NEWLIB_LIBC=y
```

## src/main.c
```c
/*
 * Copyright (c) 2012-2014 Wind River Systems, Inc.
 *
 * SPDX-License-Identifier: Apache-2.0
 */
#include <stdlib.h>
#include <math.h>
#include <string.h>
#include <stdio.h>
#include <zephyr.h>
#include <sys/printk.h>
#include "mli_api.h"

#include "cifar10_ref_inout.h"
#include "cifar10_model.h"

#ifndef MAX
/** @def Common Maximum macro function (two values)*/
#define MAX(A,B) (((A) > (B))? (A): (B))
#endif

/** @struct error measurement metrics for two vectors  */
typedef struct ref_to_pred_output_t {
	float max_abs_err;          /**< maximum absolute error  */
	float pred_vec_length;      /**< Length of predicted vector: SQRT(sum_i(pred[i]^2))  */
	float ref_vec_length;       /**< Length of reference vector: SQRT(sum_i(ref[i]^2))  */
	float noise_vec_length;     /**< Length of reference vector: SQRT(sum_i((ref[i]-pred[i])^2))  */
	float quant_err_vec_length; /**< Length of quantized error vector: SQRT(sum_i((ref[i]-Quantized(ref[i]))^2))  */
	float ref_to_noise_snr;     /**< Signal-to-noise ratio 10*log_10((ref_vec_length+eps)/(noise_vec_length+eps))  [dB]*/
	float noise_to_quant_ratio; /**< Noise-to-quantization_err ratio (noise_vec_length)/(quant_err_vec_length+eps)  */
} ref_to_pred_output;

const unsigned char kSingleIn[IN_POINTS] = IN_IMG_12;
const float kSingleOutRef[OUT_POINTS] = OUT_PROB_12;

//========================================================================================
//
// Other internal functions and routines
//
//========================================================================================

//================================================================================
// Transform MLI FX tensor to float array
//=================================================================================
static mli_status mli_hlp_fx_tensor_to_float (const mli_tensor * src, float *dst, uint32_t dst_size) {
	uint32_t elem_num = mli_hlp_count_elem_num(src, 0);
	if (elem_num > dst_size)
		return MLI_STATUS_LENGTH_ERROR;
	if (elem_num == 0)
		return MLI_STATUS_BAD_TENSOR;

	const float scale_val = 1.0f / (float) (1u << (src->el_params.fx.frac_bits));
	if (src->el_type == MLI_EL_FX_16) {
		int16_t *src_arr = src->data;
		for (int idx = 0; idx < elem_num; idx++)
			dst[idx] = (float) (scale_val * src_arr[idx]);
	} else {
		int8_t *src_arr = src->data;
		for (int idx = 0; idx < elem_num; idx++)
			dst[idx] = (float) (scale_val * src_arr[idx]);
	}
	return MLI_STATUS_OK;
}

//========================================================================================
// Image pre-processing for CIFAR-10 net
//========================================================================================
static void cifar10_preprocessing(const void * image_, mli_tensor * net_input_) {
	const unsigned char * in = image_;
	d_type * const dst = (d_type * const)net_input_->data;

	// Copying data  to input tensor with subtraction of average.
	// Data shift may be required depending on tensor format
	if (net_input_->el_params.fx.frac_bits == 7) {
		for (int idx = 0; idx < IN_POINTS; idx++)
			dst[idx] = (d_type)((int)in[idx] - 128);
	} else if (net_input_->el_params.fx.frac_bits > 7) {
		int shift_left = net_input_->el_params.fx.frac_bits - 7;
		for (int idx = 0; idx < IN_POINTS; idx++)
			dst[idx] = (d_type)((int)in[idx] - 128) << shift_left;
	} else {
		int shift_right = 7 - net_input_->el_params.fx.frac_bits;
		for (int idx = 0; idx < IN_POINTS; idx++)
			dst[idx] = (d_type)((int)in[idx] - 128)  >> shift_right; // w/o rounding
	}
}

//================================================================================
// Measure various error metrics between two float vectors
//=================================================================================
static int measure_err_vfloat(const float * ref_vec, const float * pred_vec, const int len,
			ref_to_pred_output *out) {
	float ref_accum = 0.f;
	float pred_accum = 0.f;
	float noise_accum = 0.f;
	float max_err = -1.f;

	if (len <= 0) {
		return -1;
	}
	for (int i = 0; i < len; i++) {
		ref_accum += ref_vec[i] * ref_vec[i];
		pred_accum += pred_vec[i] * pred_vec[i];
		noise_accum += (ref_vec[i] - pred_vec[i]) * (ref_vec[i] - pred_vec[i]);
		max_err = MAX(fabsf(ref_vec[i] - pred_vec[i]), max_err);
	}

	const float eps = 0.000000000000000001f;
	out->max_abs_err = max_err;
	out->noise_to_quant_ratio = 1.0f;
	out->quant_err_vec_length = 1.0f;
	out->pred_vec_length = sqrtf(pred_accum);
	out->ref_vec_length = sqrtf(ref_accum);
	out->noise_vec_length = sqrtf(noise_accum);
	out->ref_to_noise_snr = 10.f * log10f((ref_accum + eps) / (noise_accum + eps));

	return 0;
}


extern char __embarc_mli_rom_start[];
extern char __embarc_mli_rom_end[];
extern char __embarc_mli_loadaddr_rom[];

extern char __embarc_mli_data_start[];
extern char __embarc_mli_data_end[];
extern char __embarc_mli_loadaddr_data[];

extern char __embarc_mli_zdata_start[];
extern char __embarc_mli_zdata_end[];
extern char __embarc_mli_loadaddr_zdata[];

extern char __embarc_mli_model_p2_start[];
extern char __embarc_mli_model_p2_end[];
extern char __embarc_mli_loadaddr_model_p2[];

extern char __embarc_mli_model_start[];
extern char __embarc_mli_model_end[];
extern char __embarc_mli_loadaddr_model[];

extern char __embarc_mli_bss_start[];
extern char __embarc_mli_bss_end[];

extern char __embarc_mli_xdata_start[];
extern char __embarc_mli_xdata_end[];

extern char __embarc_mli_ydata_start[];
extern char __embarc_mli_ydata_end[];


void embarc_mli_init(void)
{
	(void)memcpy(&__embarc_mli_rom_start, &__embarc_mli_loadaddr_rom,
		 __embarc_mli_rom_end - __embarc_mli_rom_start);

	(void)memcpy(&__embarc_mli_data_start, &__embarc_mli_loadaddr_data,
		 __embarc_mli_data_end - __embarc_mli_data_start);

	(void)memcpy(&__embarc_mli_zdata_start, &__embarc_mli_loadaddr_zdata,
		 __embarc_mli_zdata_end - __embarc_mli_zdata_start);

	(void)memcpy(&__embarc_mli_model_p2_start, &__embarc_mli_loadaddr_model_p2,
		 __embarc_mli_model_p2_end - __embarc_mli_model_p2_start);

	(void)memcpy(&__embarc_mli_model_start, &__embarc_mli_loadaddr_model,
		 __embarc_mli_model_end - __embarc_mli_model_start);

	(void)memset(__embarc_mli_bss_start, 0,
		 __embarc_mli_bss_end - __embarc_mli_bss_start);

	(void)memset(__embarc_mli_xdata_start, 0,
		 __embarc_mli_xdata_end - __embarc_mli_xdata_start);

	(void)memset(__embarc_mli_ydata_start, 0,
		 __embarc_mli_ydata_end - __embarc_mli_ydata_start);

}

void _init_ad(void)
{
	__asm__ volatile(
		"lr r0, [0xa]\n\t"
		"bset r0, r0, 19\n\t"
		"flag r0\n\t"
		::);
}


int main(void)
{
	embarc_mli_init();

	size_t output_elements = mli_hlp_count_elem_num(cifar10_cf_net_output, 0);
	float * pred_data = malloc(output_elements * sizeof(float));

	if (pred_data == NULL) {
		printf("ERROR: Can't allocate memory for output\n");
		return -1;
	}

	cifar10_preprocessing(kSingleIn, cifar10_cf_net_input);

	cifar10_cf_net();

// Check result
	if (MLI_STATUS_OK == mli_hlp_fx_tensor_to_float(cifar10_cf_net_output, pred_data, output_elements)) {
		ref_to_pred_output err;
		measure_err_vfloat(kSingleOutRef, pred_data, output_elements, &err);
		//printf("Result Quality: S/N=%f (%f db)\n", err.ref_vec_length / err.noise_vec_length, err.ref_to_noise_snr);
	} else {
		printf("ERROR: Can't transform out tensor to float\n");
	}
	free(pred_data);
	return 0;
}
```

## src/cifar10_constants.h
```c
/*
* Copyright 2019, Synopsys, Inc.
* All rights reserved.
*
* This source code is licensed under the BSD-3-Clause license found in
* the LICENSE file in the root directory of this source tree.
*
*/

#ifndef _CIFAR10_CONSTANTS_H_
#define _CIFAR10_CONSTANTS_H_

#include "mli_config.h"
#include "cifar10_model.h"

#if (ARC_PLATFORM == V2DSP_XY) && defined (__GNUC__) && !defined (__CCAC__)
#define EMBARC_MLI_XY_ATTR
#else
#define EMBARC_MLI_XY_ATTR __xy
#endif

// Model Weights attribute
#define _Wdata_attr __attribute__((section(".mli_model")))
#define _W EMBARC_MLI_XY_ATTR _Wdata_attr

// Model Weights (part 2) attribute
#define _W2data_attr __attribute__((section(".mli_model_p2")))
#define _W2 EMBARC_MLI_XY_ATTR _W2data_attr

// Bank X (XCCM) attribute
#define __Xdata_attr __attribute__((section(".Xdata")))
#define _X EMBARC_MLI_XY_ATTR __Xdata_attr

// Bank Y (YCCM) attribute
#define __Ydata_attr __attribute__((section(".Ydata")))
#define _Y EMBARC_MLI_XY_ATTR __Ydata_attr

// Bank Z (DCCM) attribute
#define __Zdata_attr __attribute__((section(".Zdata")))
#define _Z EMBARC_MLI_XY_ATTR __Zdata_attr

// Defining weight data type
//===================================
#if (MODEL_BIT_DEPTH != MODEL_FX_16)
#define W_EL_TYPE (MLI_EL_FX_8)
typedef int8_t w_type;
#else
#define W_EL_TYPE (MLI_EL_FX_16)
typedef int16_t w_type;
#endif

//======================================================
//
// Common data transform (Qmn) defines
//
//======================================================

#define QMN(type, fraq, val)   (type)(val * (1u << (fraq)) + ((val >= 0)? 0.5f: -0.5f))
#define FRQ_BITS(int_part, el_type) ((sizeof(el_type)*8)-int_part-1)

//======================================================
//
// Common data transform (Qmn) defines
//
//======================================================

extern const w_type  _W  L1_conv_wt_buf[];
extern const w_type  _W  L1_conv_bias_buf[];

extern const w_type  _W  L2_conv_wt_buf[];
extern const w_type  _W  L2_conv_bias_buf[];

extern const w_type  _W2  L3_conv_wt_buf[];
extern const w_type  _W2  L3_conv_bias_buf[];

extern const w_type  _W2  L4_fc_wt_buf[];
extern const w_type  _W2  L4_fc_bias_buf[];

#if defined(MODEL_BIG)
extern const w_type  _W2  L5_fc_wt_buf[];
extern const w_type  _W2  L5_fc_bias_buf[];
#endif

//======================================================
//
// Tensor's Integer bits per layer definitions
//
//======================================================
#if !defined(MODEL_BIG) // Small Model
#if (MODEL_BIT_DEPTH == MODEL_FX_16)

#define CONV1_W_INT   (-1)
#define CONV1_B_INT   (0)
#define CONV1_OUT_INT (4)

#define CONV2_W_INT   (-1)
#define CONV2_B_INT   (-1)
#define CONV2_OUT_INT (5)

#define CONV3_W_INT   (-1)
#define CONV3_B_INT   (-2)
#define CONV3_OUT_INT (6)

#define FC4_W_INT   (-1)
#define FC4_B_INT   (-2)
#define FC4_OUT_INT (5)

#else //(MODEL_BIT_DEPTH == MODEL_FX_8 or MODEL_FX_8W16D)

#define CONV1_W_INT   (-1)
#define CONV1_B_INT   (0)
#define CONV1_OUT_INT (3)

#define CONV2_W_INT   (-1)
#define CONV2_B_INT   (-1)
#define CONV2_OUT_INT (5)

#define CONV3_W_INT   (-1)
#define CONV3_B_INT   (-2)
#define CONV3_OUT_INT (5)

#define FC4_W_INT   (-1)
#define FC4_B_INT   (-2)
#define FC4_OUT_INT (5)

#endif

#else // Big Model
#if (MODEL_BIT_DEPTH == MODEL_FX_16)

#define CONV1_W_INT   (0)
#define CONV1_B_INT   (0)
#define CONV1_OUT_INT (5)

#define CONV2_W_INT   (-1)
#define CONV2_B_INT   (-1)
#define CONV2_OUT_INT (6)

#define CONV3_W_INT   (-2)
#define CONV3_B_INT   (-2)
#define CONV3_OUT_INT (5)

#define FC4_W_INT   (-1)
#define FC4_B_INT   (-3)
#define FC4_OUT_INT (3)

#define FC5_W_INT   (0)
#define FC5_B_INT   (-2)
#define FC5_OUT_INT (5)


#else //(MODEL_BIT_DEPTH == MODEL_FX_8 or MODEL_FX_8W16D)

#define CONV1_W_INT   (0)
#define CONV1_B_INT   (0)
#define CONV1_OUT_INT (4)

#define CONV2_W_INT   (-1)
#define CONV2_B_INT   (-1)
#define CONV2_OUT_INT (5)

#define CONV3_W_INT   (-2)
#define CONV3_B_INT   (-2)
#define CONV3_OUT_INT (4)

#define FC4_W_INT   (-2)
#define FC4_B_INT   (-3)
#define FC4_OUT_INT (3)

#define FC5_W_INT   (0)
#define FC5_B_INT   (-2)
#define FC5_OUT_INT (5)

#endif
#endif

//======================================================
//
// Shape and Fractional bits per layer definitions
//
//======================================================

// CONV1
//================================================
#define CONV1_W_SHAPE {32,3,5,5}
#define CONV1_W_ELEMENTS (32*3*5*5)
#define CONV1_W_RANK (4)

#define CONV1_W_FRAQ   (FRQ_BITS(CONV1_W_INT, w_type))
#define L1_WQ(val)   QMN(w_type, CONV1_W_FRAQ, val)

#define CONV1_B_ELEMENTS (32)
#define CONV1_B_SHAPE {32}
#define CONV1_B_RANK (1)

#define CONV1_B_FRAQ   (FRQ_BITS(CONV1_B_INT, w_type))
#define L1_BQ(val)   QMN(w_type, CONV1_B_FRAQ, val)

#define CONV1_OUT_FRAQ (FRQ_BITS(CONV1_OUT_INT, d_type))

// CONV2
//================================================
#if defined(MODEL_BIG)
#define CONV2_W_SHAPE {32,32,5,5}
#define CONV2_W_ELEMENTS (32*32*5*5)
#define CONV2_B_SHAPE {32}
#define CONV2_B_ELEMENTS (32)
#else // Small Model
#define CONV2_W_SHAPE {16,32,5,5}
#define CONV2_W_ELEMENTS (16*32*5*5)
#define CONV2_B_SHAPE {16}
#define CONV2_B_ELEMENTS (16)
#endif

#define CONV2_W_RANK (4)
#define CONV2_B_RANK (1)

#define CONV2_W_FRAQ   (FRQ_BITS(CONV2_W_INT, w_type))
#define L2_WQ(val)   QMN(w_type, CONV2_W_FRAQ, val)
#define CONV2_B_FRAQ   (FRQ_BITS(CONV2_B_INT, w_type))
#define L2_BQ(val)   QMN(w_type, CONV2_B_FRAQ, val)
#define CONV2_OUT_FRAQ (FRQ_BITS(CONV2_OUT_INT, d_type))

// CONV3
//================================================
#if defined(MODEL_BIG)
#define CONV3_W_SHAPE {64,32,5,5}
#define CONV3_W_ELEMENTS (64*32*5*5)
#define CONV3_B_SHAPE {64}
#define CONV3_B_ELEMENTS (64)
#else // Small Model
#define CONV3_W_SHAPE {32,16,5,5}
#define CONV3_W_ELEMENTS (32*16*5*5)
#define CONV3_B_SHAPE {32}
#define CONV3_B_ELEMENTS (32)
#endif
#define CONV3_W_RANK (4)
#define CONV3_B_RANK (1)

#define CONV3_W_FRAQ   (FRQ_BITS(CONV2_W_INT, w_type))
#define L3_WQ(val)   QMN(w_type, CONV2_W_FRAQ, val)
#define CONV3_B_FRAQ   (FRQ_BITS(CONV2_B_INT, w_type))
#define L3_BQ(val)   QMN(w_type, CONV2_B_FRAQ, val)
#define CONV3_OUT_FRAQ (FRQ_BITS(CONV2_OUT_INT, d_type))

// FC4
//================================================
#if defined(MODEL_BIG)
#define FC4_W_SHAPE {64,(64*16)}
#define FC4_W_ELEMENTS (64*(64*16))
#define FC4_B_SHAPE {64}
#define FC4_B_ELEMENTS (64)
#else // Small Model
#define FC4_W_SHAPE {10,(32*16)}
#define FC4_W_ELEMENTS (10*(32*16))
#define FC4_B_SHAPE {10}
#define FC4_B_ELEMENTS (10)
#endif
#define FC4_W_RANK (2)
#define FC4_B_RANK (1)

#define FC4_W_FRAQ   (FRQ_BITS(FC4_W_INT, w_type))
#define L4_WQ(val)   QMN(w_type, FC4_W_FRAQ, val)
#define FC4_B_FRAQ   (FRQ_BITS(FC4_B_INT, w_type))
#define L4_BQ(val)   QMN(w_type, FC4_B_FRAQ, val)
#define FC4_OUT_FRAQ (FRQ_BITS(FC4_OUT_INT, d_type))


#if defined(MODEL_BIG)
// FC5
//================================================
#define FC5_W_SHAPE {10,64}
#define FC5_W_ELEMENTS (10*64)
#define FC5_W_RANK (2)

#define FC5_W_FRAQ   (FRQ_BITS(FC5_W_INT, w_type))
#define L5_WQ(val)   QMN(w_type, FC5_W_FRAQ, val)

#define FC5_B_ELEMENTS (10)
#define FC5_B_SHAPE {10}
#define FC5_B_RANK (1)

#define FC5_B_FRAQ   (FRQ_BITS(FC5_B_INT, w_type))
#define L5_BQ(val)   QMN(w_type, FC5_B_FRAQ, val)

#define FC5_OUT_FRAQ (FRQ_BITS(FC5_OUT_INT, d_type))
#endif // defined(MODEL_BIG)

#endif  //_CIFAR10_CONSTANTS_H_
```

## src/cifar10_model.h
```c
/*
* Copyright 2019, Synopsys, Inc.
* All rights reserved.
*
* This source code is licensed under the BSD-3-Clause license found in
* the LICENSE file in the root directory of this source tree.
*
*/

//
// Convolutional Neural network model for small pictures classification.
// Based on standart Caffe [1] example for CIFAR-10 [2] dataset
//
// Correspondence of classes:
//  0: airplane
//  1: automobile
//  2: bird
//  3: cat
//  4: deer
//  5: dog
//  6: frog
//  7: horse
//  8: ship
//  9: truck
//
//  [1] https://github.com/BVLC/caffe/tree/master/examples/cifar10
//  [2] https://www.cs.toronto.edu/~kriz/cifar.html

#ifndef _CIFAR10_MODEL_H_
#define _CIFAR10_MODEL_H_

#include <stdint.h>

#include "mli_types.h"

//=============================================
//
// Model interface
//
//=============================================
// Input tensor. To be filled with input image by user befor calling inference function (cifar10_cf_net).
#define IN_POINTS (32 * 32 * 3)
extern mli_tensor * const cifar10_cf_net_input;

// Output tensor for model. Will be filled with probabilities vector by model
#define OUT_POINTS (10)
extern mli_tensor * const cifar10_cf_net_output;

// Model inference function
//
// Get input data from cifar10_cf_net_input tensor (FX format), fed it to the neural network,
// and writes results to cifar10_cf_net_output tensor (FX format). It is user responsibility
// to prepare input tensor correctly before calling this function and get result from output tensor
// after function finish
void cifar10_cf_net(void);


//=============================================
//
// Model bit depth configuration
//
//=============================================
#define MODEL_FX_8       (8)
#define MODEL_FX_16      (16)
#define MODEL_FX_8W16D   (816)

#define MODEL_BIT_DEPTH MODEL_FX_8

#if !defined(MODEL_BIT_DEPTH)
#define MODEL_BIT_DEPTH (MODEL_FX_16)
#endif

#if !defined(MODEL_BIT_DEPTH) || \
    (MODEL_BIT_DEPTH != MODEL_FX_8 && MODEL_BIT_DEPTH != MODEL_FX_16 && MODEL_BIT_DEPTH != MODEL_FX_8W16D)
#error "MODEL_BIT_DEPTH must be defined correctly!"
#endif

#if (MODEL_BIT_DEPTH == MODEL_FX_8)
typedef int8_t d_type;
#else
typedef int16_t d_type;
#endif

#endif  //_CIFAR10_MODEL_H_
```

## src/cifar10_model_chw.c
```c
/*
* Copyright 2019, Synopsys, Inc.
* All rights reserved.
*
* This source code is licensed under the BSD-3-Clause license found in
* the LICENSE file in the root directory of this source tree.
*
*/

#include "cifar10_model.h"

#include "mli_api.h"
#include "mli_types.h"
#include "mli_config.h"

#include "cifar10_constants.h"

#if (MODEL_BIT_DEPTH == MODEL_FX_8)
#define D_EL_TYPE (MLI_EL_FX_8)
#else
#define D_EL_TYPE (MLI_EL_FX_16)
#endif

//==============================================================
//
//
// Data related to the Module
//
//
//==============================================================

// Intermediate data buffers (enough size for max intermediate results)
//==============================
#define IR_BUF_SZ_MOST (32*32*32) //32768
#define IR_BUF_SZ_NEXT (32*16*16)
static d_type  _Z    x_mem_buf[IR_BUF_SZ_MOST];
static d_type  _Y    y_mem_buf[IR_BUF_SZ_NEXT];

// Module Input/Output tensors and their's external interface
//============================================================
static mli_tensor input = {
	.data = (void *)x_mem_buf,
	.capacity = sizeof(d_type) * IN_POINTS,
	.shape = {32, 32, 3},
	.rank = 3,
	.el_type = D_EL_TYPE,
	.el_params.fx.frac_bits = 7,
};

static mli_tensor output = {
	.data = (void *)y_mem_buf,
	.capacity = sizeof(d_type) * OUT_POINTS,
	.shape = {10},
	.rank = 1,
	.el_type = D_EL_TYPE,
	.el_params.fx.frac_bits = 0,
};

// Interface variables: Available to user via main model header
//===========================================================
mli_tensor * const cifar10_cf_net_input = &input;
mli_tensor * const cifar10_cf_net_output = &output;


//==============================================================
//  Model description and configuration
//==============================================================


// Configuration objects for layers
//===============================================

static const mli_permute_cfg permute_hwc2chw_cfg = {
	.perm_dim = {2, 0, 1}
};

static const mli_conv2d_cfg shared_conv_cfg = {
	.stride_height = 1, .stride_width = 1,
	.padding_bottom = 2, .padding_top = 2,
	.padding_left = 2, .padding_right = 2,
	.relu.type = MLI_RELU_GEN
};

static const mli_pool_cfg shared_pool_cfg = {
	.kernel_height = 3,	.kernel_width = 3,
	.stride_height = 2, .stride_width = 2,
	.padding_bottom = 1, .padding_top = 0,
	.padding_left = 0, .padding_right = 1
};


// Conv 1 Layer related tensors
//===================================
static const mli_tensor L1_conv_wt = {
	.data = (void *)L1_conv_wt_buf,
	.capacity = CONV1_W_ELEMENTS * sizeof(w_type),
	.shape = CONV1_W_SHAPE,
	.rank = CONV1_W_RANK,
	.el_type = W_EL_TYPE,
	.el_params.fx.frac_bits = CONV1_W_FRAQ,
};


static const mli_tensor L1_conv_bias = {
	.data = (void *)L1_conv_bias_buf,
	.capacity = CONV1_B_ELEMENTS * sizeof(w_type),
	.shape = CONV1_B_SHAPE,
	.rank = CONV1_B_RANK,
	.el_type = W_EL_TYPE,
	.el_params.fx.frac_bits = CONV1_B_FRAQ,
};


// Conv 2 Layer related data
//===================================
static mli_tensor L2_conv_wt = {
	.data = (void *)L2_conv_wt_buf,
	.capacity = CONV2_W_ELEMENTS * sizeof(w_type),
	.shape = CONV2_W_SHAPE,
	.rank = CONV2_W_RANK,
	.el_type = W_EL_TYPE,
	.el_params.fx.frac_bits = CONV2_W_FRAQ,
};

static mli_tensor L2_conv_bias = {
	.data = (void *)L2_conv_bias_buf,
	.capacity = CONV2_B_ELEMENTS * sizeof(w_type),
	.shape = CONV2_B_SHAPE,
	.rank = CONV2_B_RANK,
	.el_type = W_EL_TYPE,
	.el_params.fx.frac_bits = CONV2_B_FRAQ,
};


// Conv 3 Layer related data
//===================================
static mli_tensor L3_conv_wt = {
	.data = (void *)L3_conv_wt_buf,
	.capacity = CONV3_W_ELEMENTS * sizeof(w_type),
	.shape = CONV3_W_SHAPE,
	.rank = CONV3_W_RANK,
	.el_type = W_EL_TYPE,
	.el_params.fx.frac_bits = CONV3_W_FRAQ,
};

static mli_tensor L3_conv_bias = {
	.data = (void *)L3_conv_bias_buf,
	.capacity = CONV3_B_ELEMENTS * sizeof(w_type),
	.shape = CONV3_B_SHAPE,
	.rank = CONV3_B_RANK,
	.el_type = W_EL_TYPE,
	.el_params.fx.frac_bits = CONV3_B_FRAQ,
};


// FC4 Layer related data
//===================================
static mli_tensor L4_fc_wt = {
	.data = (void *)L4_fc_wt_buf,
	.capacity = FC4_W_ELEMENTS * sizeof(w_type),
	.shape = FC4_W_SHAPE,
	.rank = FC4_W_RANK,
	.el_type = W_EL_TYPE,
	.el_params.fx.frac_bits = FC4_W_FRAQ,
};

static mli_tensor L4_fc_bias = {
	.data = (void *)L4_fc_bias_buf,
	.capacity = FC4_B_ELEMENTS * sizeof(w_type),
	.shape = FC4_B_SHAPE,
	.rank = FC4_B_RANK,
	.el_type = W_EL_TYPE,
	.el_params.fx.frac_bits = FC4_B_FRAQ,
};

#if defined(MODEL_BIG)
// FC5 Layer related data
//===================================
static mli_tensor L5_fc_wt = {
	.data = (void *)L5_fc_wt_buf,
	.capacity = FC5_W_ELEMENTS * sizeof(w_type),
	.shape = FC5_W_SHAPE,
	.rank = FC5_W_RANK,
	.el_type = W_EL_TYPE,
	.el_params.fx.frac_bits = FC5_W_FRAQ,
};

static mli_tensor L5_fc_bias = {
	.data = (void *)L5_fc_bias_buf,
	.capacity = FC5_B_ELEMENTS * sizeof(w_type),
	.shape = FC5_B_SHAPE,
	.rank = FC5_B_RANK,
	.el_type = W_EL_TYPE,
	.el_params.fx.frac_bits = FC5_B_FRAQ,
};
#endif //#if defined(MODEL_BIG)

// Intermediate result tensors
//===============================================
static mli_tensor ir_tensor_X = {
	.data = (void *)x_mem_buf,
	.capacity = sizeof(x_mem_buf),
	.shape = {0, 0, 0, 0},
	.rank = 4,
	.el_type = D_EL_TYPE,
	.el_params.fx.frac_bits = FRQ_BITS(0, d_type),
};

static mli_tensor ir_tensor_Y = {
	.data = (void *)y_mem_buf,
	.capacity = sizeof(y_mem_buf),
	.shape = {0, 0, 0, 0},
	.rank = 4,
	.el_type = D_EL_TYPE,
	.el_params.fx.frac_bits = FRQ_BITS(0, d_type),
};


//==============================================================
//  Wrappers on MLI calls to deal with various
//  bit depth configurable in compile time
//==============================================================
static inline mli_status maxpool_chw(const mli_tensor *in, const mli_pool_cfg *cfg, mli_tensor *out);

static inline mli_status avepool_chw(const mli_tensor *in, const mli_pool_cfg *cfg, mli_tensor *out);

static inline mli_status softmax(const mli_tensor *in,	mli_tensor *out);

static inline mli_status relu(const mli_tensor *in, const mli_relu_cfg *cfg, mli_tensor *out);

static inline mli_status mli_krn_permute_fx(const mli_tensor *in, const mli_permute_cfg *cfg, mli_tensor *out);

static inline mli_status conv2d_chw(
	const mli_tensor *in,
	const mli_tensor *weights,
	const mli_tensor *bias,
	const mli_conv2d_cfg *cfg,
	mli_tensor *out);

static inline mli_status fully_connected(
	const mli_tensor *in,
	const mli_tensor  *weights,
	const mli_tensor  *bias,
	mli_tensor *out);


//==============================================================
//
//  CIFAR10 graph based on Caffe example.
//  Layer-by-Layer execution for CHW layput
//
//==============================================================
void cifar10_cf_net(void) {
	// Version A: Pure implementation: without return status checking and profiling wrappers
	//========================================================================================
	// LAYER 0: Change RGB Image layout
	//=======================================
	mli_krn_permute_fx(&input, &permute_hwc2chw_cfg, &ir_tensor_Y);

	// LAYER 1
	//=======================================
	ir_tensor_X.el_params.fx.frac_bits = CONV1_OUT_FRAQ;
	conv2d_chw(&ir_tensor_Y, &L1_conv_wt, &L1_conv_bias, &shared_conv_cfg, &ir_tensor_X);
	maxpool_chw(&ir_tensor_X, &shared_pool_cfg, &ir_tensor_Y);

	// LAYER 2
	//=======================================
	ir_tensor_X.el_params.fx.frac_bits = CONV2_OUT_FRAQ;
	conv2d_chw(&ir_tensor_Y, &L2_conv_wt, &L2_conv_bias, &shared_conv_cfg, &ir_tensor_X);
	avepool_chw(&ir_tensor_X, &shared_pool_cfg, &ir_tensor_Y);

	// LAYER 3
	//=======================================
	ir_tensor_X.el_params.fx.frac_bits = CONV3_OUT_FRAQ;
	conv2d_chw(&ir_tensor_Y, &L3_conv_wt, &L3_conv_bias, &shared_conv_cfg, &ir_tensor_X);
	avepool_chw(&ir_tensor_X, &shared_pool_cfg, &ir_tensor_Y);

	// LAYER 4
	//=======================================
	ir_tensor_X.el_params.fx.frac_bits = FC4_OUT_FRAQ;
	fully_connected(&ir_tensor_Y, &L4_fc_wt, &L4_fc_bias, &ir_tensor_X);

#if defined(MODEL_BIG)
	// LAYER 5
	//=======================================
	ir_tensor_Y.el_params.fx.frac_bits = FC5_OUT_FRAQ;
	fully_connected(&ir_tensor_X, &L5_fc_wt, &L5_fc_bias, &ir_tensor_Y);
	softmax(&ir_tensor_Y, &output);
#else
	softmax(&ir_tensor_X, &output);
#endif

}

//========================================================================================
//  MLI Functions wrappers: Kernels w/o weights
//========================================================================================
#if (MODEL_BIT_DEPTH != MODEL_FX_8)
static inline mli_status maxpool_chw(const mli_tensor *in, const mli_pool_cfg *cfg, mli_tensor *out) {
	return mli_krn_maxpool_chw_fx16_k3x3(in, cfg, out);
}

static inline mli_status avepool_chw(const mli_tensor *in, const mli_pool_cfg *cfg, mli_tensor *out) {
	return mli_krn_avepool_chw_fx16_k3x3_krnpad(in, cfg, out);
}

static inline mli_status softmax(const mli_tensor *in,	mli_tensor *out) {
	return mli_krn_softmax_fx16(in, out);
}

static inline mli_status relu(const mli_tensor *in, const mli_relu_cfg *cfg, mli_tensor *out) {
	return mli_krn_relu_fx16(in, cfg, out);
}

static inline mli_status mli_krn_permute_fx(const mli_tensor *in, const mli_permute_cfg *cfg, mli_tensor *out) {
	return mli_krn_permute_fx16(in, cfg, out);
}

#else // MODEL_BIT_DEPTH == (MODEL_FX_8W16D || MODEL_FX_8W16D)
static inline mli_status maxpool_chw(const mli_tensor *in, const mli_pool_cfg *cfg, mli_tensor *out) {
	return mli_krn_maxpool_chw_fx8_k3x3(in, cfg, out);
}

static inline mli_status avepool_chw(const mli_tensor *in, const mli_pool_cfg *cfg, mli_tensor *out) {
	return mli_krn_avepool_chw_fx8_k3x3_krnpad(in, cfg, out);
}

static inline mli_status softmax(const mli_tensor *in,	mli_tensor *out) {
	return mli_krn_softmax_fx8(in, out);
}

static inline mli_status relu(const mli_tensor *in, const mli_relu_cfg *cfg, mli_tensor *out) {
	return mli_krn_relu_fx8(in, cfg, out);
}

static inline mli_status mli_krn_permute_fx(const mli_tensor *in, const mli_permute_cfg *cfg, mli_tensor *out) {
	return mli_krn_permute_fx8(in, cfg, out);
}

#endif

//========================================================================================
//  MLI Functions wrappers: Kernels with weights
//========================================================================================
#if (MODEL_BIT_DEPTH == MODEL_FX_8)
static inline mli_status conv2d_chw(
	const mli_tensor *in,
	const mli_tensor *weights,
	const mli_tensor *bias,
	const mli_conv2d_cfg *cfg,
	mli_tensor *out) {
	return mli_krn_conv2d_chw_fx8_k5x5_str1_krnpad(in, weights, bias, cfg, out);
}

static inline mli_status fully_connected(
	const mli_tensor *in,
	const mli_tensor *weights,
	const mli_tensor *bias,
	mli_tensor *out) {
	return mli_krn_fully_connected_fx8(in, weights, bias, out);
}

#elif (MODEL_BIT_DEPTH == MODEL_FX_16)
static inline mli_status conv2d_chw(
	const mli_tensor *in,
	const mli_tensor *weights,
	const mli_tensor *bias,
	const mli_conv2d_cfg *cfg,
	mli_tensor *out) {
	return mli_krn_conv2d_chw_fx16_k5x5_str1_krnpad(in, weights, bias, cfg, out);
}

static inline mli_status fully_connected(
	const mli_tensor *in,
	const mli_tensor *weights,
	const mli_tensor *bias,
	mli_tensor *out) {
	return mli_krn_fully_connected_fx16(in, weights, bias, out);
}

#else // MODEL_BIT_DEPTH == MODEL_FX_8W16D
static inline mli_status conv2d_chw(
	const mli_tensor *in,
	const mli_tensor *weights,
	const mli_tensor *bias,
	const mli_conv2d_cfg *cfg,
	mli_tensor *out) {
	return mli_krn_conv2d_chw_fx8w16d(in, weights, bias, cfg, out);
}

static inline mli_status fully_connected(
	const mli_tensor *in,
	const mli_tensor *weights,
	const mli_tensor *bias,
	mli_tensor *out) {
	return mli_krn_fully_connected_fx8w16d(in, weights, bias, out);
}
#endif
```
