## soc/riscv/snps_av5rmx/rmx5x/Kconfig.defconfig.series
```kconfig
# Copyright (c) 2024 Synopsys
# SPDX-License-Identifier: Apache-2.0

if SOC_SERIES_RMX5X

config SOC_SERIES
	default "rmx5x"
	
config SYS_CLOCK_HW_CYCLES_PER_SEC
	default 5000000

config RISCV_SOC_INTERRUPT_INIT
	default y

config 2ND_LVL_ISR_TBL_OFFSET
	default 12

config 2ND_LVL_INTR_00_OFFSET
	default 11

#config UART_NS16550_ACCESS_WORD_ONLY
#	default y
#	depends on UART_NS16550

config NUM_IRQS
	default 128

config RISCV_GP
	default y	

endif # SOC_SERIES_RMX5X
```

## soc/snps/nsim/arc_classic/hs/Kconfig
```kconfig
# Copyright (c) 2024 Synopsys, Inc.
# SPDX-License-Identifier: Apache-2.0

config SOC_SERIES_NSIM_HS
	select ARC
	select CPU_HAS_FPU
	# Autotalks HS48x2 has an MPUv6 even in the SMP configuration, so expose
	# the MPU regardless of SMP (upstream only enabled it for !SMP).
	select CPU_HAS_MPU
```

## soc/snps/nsim/arc_v/rhx/Kconfig
```kconfig
# Copyright (c) 2024 Synopsys, Inc.
# SPDX-License-Identifier: Apache-2.0

config SOC_SERIES_NSIM_ARC_V_RHX
	bool
	select RISCV
	select RISCV_PRIVILEGED
	select RISCV_HAS_CLINT
    select RISCV_ISA_EXT_A
	select RISCV_ISA_EXT_C
	select RISCV_ISA_EXT_M
	select RISCV_ISA_EXT_ZICSR
	select RISCV_ISA_EXT_ZIFENCEI
    
	help
	  Enable support for Synopsys ARC-V nSIM RHX series
```

## soc/snps/nsim/arc_v/rhx/Kconfig.defconfig
```kconfig
# Copyright (c) 2024 Synopsys, Inc.
# SPDX-License-Identifier: Apache-2.0

if SOC_SERIES_RHX

config XIP
	default y

config SYS_CLOCK_HW_CYCLES_PER_SEC
	default $(dt_node_int_prop_int,/cpus/cpu@0,clock-frequency)

config NUM_IRQS
	default 32

config PMP_SLOTS
	default 32

config PMP_GRANULARITY
	default 32

config RISCV_PMP
	default y

config RISCV_SOC_INTERRUPT_INIT
	default y

# Disable Zcmp as GCC 12.2.0 doesn't support it
config RISCV_ISA_EXT_ZCMP
	default n

endif # SOC_SERIES_RHX
```

## soc/snps/nsim/arc_v/rhx/Kconfig.defconfig.rhx100
```kconfig
# Copyright (c) 2024 Synopsys, Inc.
# SPDX-License-Identifier: Apache-2.0

if SOC_NSIM_ARC_V_RHX100

config NUM_IRQS
	default 32

# Enable all RISC-V ISA extensions for RHX100
config RISCV_ISA_EXT_M
	default y

config RISCV_ISA_EXT_A
	default y

config RISCV_ISA_EXT_C
	default y

config RISCV_ISA_EXT_D
	default y

config RISCV_ISA_EXT_F
	default y

config RISCV_ISA_EXT_ZICSR
	default y

config RISCV_ISA_EXT_ZIFENCEI
	default y

config RISCV_ISA_EXT_ZBA
	default y

config RISCV_ISA_EXT_ZBB
	default y

config RISCV_ISA_EXT_ZBC
	default y

config RISCV_ISA_EXT_ZBS
	default y

# Note: H, S, U extensions are privilege level extensions
# and other extensions like ZFH, ZICOND, ZICBOM, ZICBOP
# may need to be added to arch/riscv/Kconfig.isa if not already present

endif # SOC_NSIM_ARC_V_RHX100
```

## soc/snps/nsim/arc_v/rhx/Kconfig.soc
```kconfig
# Copyright (c) 2024 Synopsys, Inc.
# SPDX-License-Identifier: Apache-2.0

config SOC_SERIES_NSIM_ARC_V_RHX
	bool
	select SOC_FAMILY_NSIM_ARC_V
    select CPU_HAS_FPU
    select RISCV_ISA_EXT_F  # For single precision
    select RISCV_ISA_EXT_D  # For double precision
	help
	  Synopsys ARC-V nSIM RHX series

config SOC_NSIM_ARC_V_RHX100
	bool
	select SOC_SERIES_NSIM_ARC_V_RHX
    select CPU_HAS_FPU
    select RISCV_ISA_EXT_F  # For single precision
    select RISCV_ISA_EXT_D  # For double precision
	help
	  Synopsys ARC-V nSIM RHX100 SoC

config SOC
	default "nsim_arc_v_rhx100" if SOC_NSIM_ARC_V_RHX100
```

## sysbuild/Kconfig
```kconfig
# Copyright (c) 2021 Nordic Semiconductor
#
# SPDX-License-Identifier: Apache-2.0

comment "Sysbuild image configuration"

osource "$(BOARD_DIR)/Kconfig.sysbuild"

config WARN_EXPERIMENTAL
	bool
	prompt "Warn on experimental usage"
	help
	  Print a warning when the Kconfig tree is parsed if any experimental
	  features are enabled.

config SB_SUPPORT_BOOTLOADER
	bool
	default y

config SB_SUPPORT_BOOTLOADER_MCUBOOT_ZEPHYR
	bool
	default y

choice SB_BOOTLOADER
	prompt "Bootloader support"
	default SB_BOOTLOADER_NONE
	depends on SB_SUPPORT_BOOTLOADER

config SB_BOOTLOADER_NONE
	bool "None"
	help
	  Do not Include a bootloader in the build

config SB_BOOTLOADER_MCUBOOT
	bool "MCUboot"
	depends on SB_SUPPORT_BOOTLOADER_MCUBOOT_ZEPHYR
	help
	  Include MCUboot (Zephyr port) as the bootloader to use

endchoice
```

## tests/arch/riscv/cfi/testcase.yaml
```yaml
common:
  ignore_faults: true
  tags:
    - kernel
    - cfi
  arch_allow: riscv

tests:
  arch.riscv.cfi.kernel.shstk:
    filter: CONFIG_RISCV_ISA_EXT_ZICFISS
    extra_configs:
      - CONFIG_RISCV_CFI=y
      - CONFIG_RISCV_CFI_SHADOW_STACK=y
      - CONFIG_HW_SHADOW_STACK=y

  arch.riscv.cfi.kernel.lpad:
    filter: CONFIG_RISCV_ISA_EXT_ZICFILP
    extra_configs:
      - CONFIG_RISCV_CFI=y
      - CONFIG_RISCV_CFI_LANDING_PAD=y

  arch.riscv.cfi.kernel.shstk_lpad:
    filter: CONFIG_RISCV_ISA_EXT_ZICFISS and CONFIG_RISCV_ISA_EXT_ZICFILP
    extra_configs:
      - CONFIG_RISCV_CFI=y
      - CONFIG_RISCV_CFI_SHADOW_STACK=y
      - CONFIG_HW_SHADOW_STACK=y
      - CONFIG_RISCV_CFI_LANDING_PAD=y
```

## tests/boards/arc_secure_services/crypto/testcase.yaml
```yaml
tests:
  crypto.tinycrypt:
    tags: arc tinycrypt crypto aes ccm
    timeout: 300
    integration_platforms:
      - native_posix
```

## tests/crypto/tinycrypt/testcase.yaml
```yaml
tests:
  crypto.tinycrypt:
    filter: not CONFIG_SOC_NSIM
    tags: tinycrypt crypto aes ccm
    timeout: 300
    platform_whitelist: native_posix
```

## tests/drivers/interrupt_controller/intc_riscv_aia/testcase.yaml
```yaml
common:
  arch_allow: riscv
  tags:
    - drivers
    - interrupt
    - riscv
    - aia
    - aplic
    - imsic

tests:
  drivers.interrupt_controller.intc_riscv_aia: {}
```

## tests/kernel/context/testcase.yaml
```yaml
tests:
  kernel.context:
    tags: kernel
    extra_configs:
      - CONFIG_TEST_EXTRA_STACK_SIZE=1024
    min_ram: 16
    platform_exclude:
      - iotdk  # CPU idle not supported - peripherals lose power in sleep mode
  kernel.context.minimallibc:
    filter: CONFIG_MINIMAL_LIBC_SUPPORTED
    tags:
      - kernel
      - libc
    extra_configs:
      - CONFIG_TEST_EXTRA_STACK_SIZE=1024
      - CONFIG_MINIMAL_LIBC=y
    min_ram: 16
    platform_exclude:
      - iotdk  # CPU idle not supported - peripherals lose power in sleep mode
  linker.linker_generator:
    platform_allow: qemu_cortex_m3
    tags:
      - kernel
      - linker_generator
    extra_configs:
      - CONFIG_CMAKE_LINKER_GENERATOR=y
      - CONFIG_TEST_EXTRA_STACK_SIZE=1024
```

## tests/kernel/dsp_sharing/testcase.yaml
```yaml
tests:
  kernel.dsp_sharing.generic.arc:
    toolchain_allow: arcmwdt
    filter: CONFIG_ISA_ARCV2 and CONFIG_CPU_HAS_DSP
    slow: true
    tags: dsp kernel
    timeout: 600
    min_ram: 16
```

## tests/misc/iterable_sections/testcase.yaml
```yaml
tests:
  misc.iterable_sections:
    tags: iterable_sections
    arch_exclude: posix xtensa
    toolchain_exclude: arcmwdt
```

## tests/portability/cmsis_rtos_v2/testcase.yaml
```yaml
tests:
  portability.cmsis_rtos_v2:
    platform_exclude: qemu_x86_64 m2gl025_miv
    tags: cmsis_rtos
    extra_configs:
      - CONFIG_ARC_HAS_STACK_CHECKING=n
    min_ram: 32
    min_flash: 34
```

## tests/subsys/logging/log_backend_init/testcase.yaml
```yaml
tests:
  logging.log_backend_initialization:
    integration_platforms:
      - native_posix
    tags: log_core logging
    platform_exclude: hsdk hsdk_2cores
    filter: not CONFIG_LOG_MODE_IMMEDIATE
```

## tests/subsys/logging/log_link_order/testcase.yaml
```yaml
tests:
  logging.log_link_order:
    platform_exclude: hsdk hsdk_2cores
    integration_platforms:
      - native_posix
    tags: log_links logging
    filter: not CONFIG_LOG_MODE_IMMEDIATE
```
