## arch/arc/core/secureshield/Kconfig
```kconfig
# Secure firmware configuration options

# Copyright (c) 2020 Synopsys
# SPDX-License-Identifier: Apache-2.0

config SECURE_NUM_IRQ_PRIO_LEVELS
	int "the secure interrupt levels"
	range 1 14
	default 1
	help
	  The irq priority levels used by secure firmware. The secure irq
	  priority level is always higher than normal secure irq priority
	  level.

config NORMAL_SOFT_IRQ
	int "the normal helper interrupt no"
	range 18 256
	default 19
	help
	  This helper interrupt is used to raise possible thread switch
	  request when secure firmware returns to normal firmware by
	  secure interrupt.

config SECURE_SOFT_IRQ
	int "the secure helper interrupt no"
	depends on ARC_SECURE_FIRMWARE
	range 18 256
	default 18
	help
	  This helper interrupt is used to rasie thread switch request
	  from normal irq and nested secure irq.s

config NORMAL_NUM_MPU_ENTRIES
	int "the mpu entires reserved for normal firmware"
	range 1 16
	default 8
	help
	  The MPU entires reserved for normal firmware. Secure firmware's
	  mpu request has higher priority, so the final allocated num may
	  be less than the configured one.
```

## boards/arc/emwh/Kconfig.board
```kconfig
# Kconfig - DesignWare ARC EM Wuhan board configuration
#
# Copyright (c) 2019 Synopsys, Inc. All rights reserved.
#
# SPDX-License-Identifier: Apache-2.0
#
config BOARD_EMWH
	bool "ARC EM Wuhan"
	depends on SOC_EMWH
	help
	  The DesignWare ARC EM Wuhan board is a board
	  that can host up to 3 different SOC FPGA bit files.
	  Currently, it has EM9D configuration which uses CCM
	  memories and is a Harvard Architecture.
```

## boards/arc/hsdk/Kconfig.defconfig
```kconfig
# Copyright (c) 2019 Synopsys, Inc. All rights reserved.
# SPDX-License-Identifier: Apache-2.0

if BOARD_HSDK

config BOARD
	default "hsdk"

if GPIO

config GPIO_DW
	default y

if GPIO_DW

config GPIO_DW_0
	default y

endif # GPIO_DW

endif # GPIO

if SPI

config SPI_DW
	default y

if SPI_DW

config SPI_DW_FIFO_DEPTH
	default 32

config SPI_DW_ARC_AUX_REGS
	default n

config SPI_DW_ACCESS_WORD_ONLY
	default y

config SPI_0
	default y

config SPI_1
	default y

config SPI_2
	default y

endif # SPI_DW

endif # SPI

if I2C

config I2C_DW
	default y

if I2C_DW

config I2C_DW_CLOCK_SPEED
	default 100

config I2C_0
	default y

config I2C_1
	default y

config I2C_2
	default y

endif # I2C_DW

endif # I2C


endif # BOARD_HSDK
```

## boards/arc/hsdk4xd/Kconfig.board
```kconfig
# DesignWare ARC HSDK4XD Development Kit board configuration

# Copyright (c) 2022 Synopsys, Inc. All rights reserved.
# SPDX-License-Identifier: Apache-2.0

config BOARD_HSDK4XD
	bool "ARC HSDK4XD Development Kit"
	depends on SOC_ARC_HSDK4XD
	help
	  TODO
```

## boards/arc/hsdk4xd/Kconfig.defconfig
```kconfig
# SPDX-License-Identifier: Apache-2.0

if BOARD_HSDK4XD

config BOARD
	default "hsdk4xd"

# TODO

endif #BOARD_HSDK4XD
```

## boards/arc/nsim/Kconfig.sysbuild
```kconfig
# Copyright (c) 2016, 2019 Synopsys, Inc. All rights reserved.
#
# SPDX-License-Identifier: Apache-2.0

config SB_ARC_NSIM_SEM_NORMAL
	bool
	default y if $(BOARD) = "nsim_sem_normal"
	default y if $(BOARD) = "em_starterkit_em7d_normal"

config SB_NSIM_SEM_SECURESHIELD
	bool "Secureshield image"
	depends on SB_ARC_NSIM_SEM_NORMAL
	default y
	help
	  Building a Secureshield image for nsim_sem
	  When build nsim_sem_normal with application image, then a Secureshield image
	  is required which will boot the device and create a trusted execution environment

	
```

## boards/arc/qemu_archs/Kconfig.board
```kconfig
#Copyright (c) 2019 Synopsys, Inc. All rights reserved.
#
# SPDX-License-Identifier: Apache-2.0
#
config BOARD_QEMU_ARCHS
	bool "ARC HS Emulation (QEMU)"
	depends on SOC_ARCHS_QEMU
	select QEMU_TARGET
```

## boards/arc/qemu_archs/qemu_archs_defconfig
```kconfig
CONFIG_ARC=y
CONFIG_SOC_ARCHS_QEMU=y
CONFIG_SYS_CLOCK_TICKS_PER_SEC=100
CONFIG_XIP=n
CONFIG_BUILD_OUTPUT_BIN=n
CONFIG_PRINTK=y
CONFIG_ARCV2_INTERRUPT_UNIT=y
CONFIG_ARCV2_TIMER=y
CONFIG_CONSOLE=y
CONFIG_UART_CONSOLE=y
CONFIG_SERIAL=y
CONFIG_UART_NS16550=y
CONFIG_UART_NS16550_PORT_0=y
```

## boards/qemu/riscv32_aia/board.yml
```yaml
board:
  name: qemu_riscv32_aia
  full_name: QEMU Emulation for RISCV32 AIA
  vendor: qemu
  socs:
    - name: qemu_virt_riscv32_aia
      variants:
        - name: smp
```

## boards/snps/nsim/arc_v/Kconfig.nsim_arc_v
```kconfig
# Copyright (c) 2024 Synopsys, Inc.
# SPDX-License-Identifier: Apache-2.0

config BOARD_NSIM_ARC_V
	select SOC_RMX100 if BOARD_NSIM_ARC_V_RMX100
	select CPU_HAS_FPU   
	select CPU_HAS_FPU_DOUBLE_PRECISION
	
config BOARD_NSIM_ARC_V_RHX100
	select SOC_NSIM_ARC_V_RHX100
	select CPU_HAS_FPU
	select CPU_HAS_FPU_DOUBLE_PRECISION
```

## boards/snps/nsim/arc_v/board.yml
```yaml
board:
  name: nsim_arc_v
  full_name: RISC-V nSIM and HAPS FPGA boards
  vendor: snps
  socs:
  - name: rmx100
  - name: rmx100_aia_mmsi
  - name: rhx100
```

## boards/snps/nsim/arc_v/nsim_arc_v_rhx100_defconfig
```kconfig
# Copyright (c) 2024 Synopsys, Inc.
# SPDX-License-Identifier: Apache-2.0

CONFIG_XIP=y
CONFIG_CONSOLE=y
CONFIG_SEMIHOST=y
CONFIG_SEMIHOST_CONSOLE=y
CONFIG_BUILD_OUTPUT_HEX=y
CONFIG_INCLUDE_RESET_VECTOR=y
CONFIG_LOG=y
```

## boards/snps/nsim/arc_v/nsim_arc_v_rmx100_aia_mmsi_defconfig
```kconfig
# Copyright (c) 2024 Synopsys, Inc.
# SPDX-License-Identifier: Apache-2.0

# Disable XIP - run from RAM
CONFIG_XIP=n

# Console
CONFIG_CONSOLE=y
CONFIG_SERIAL=y
CONFIG_UART_CONSOLE=y

# Build output
CONFIG_BUILD_OUTPUT_HEX=y
CONFIG_INCLUDE_RESET_VECTOR=y

# Logging
CONFIG_LOG=y

# Enable AIA support
CONFIG_RISCV_HAS_AIA=y
CONFIG_RISCV_IMSIC=y
CONFIG_RISCV_APLIC_MSI=y
CONFIG_RISCV_AIA=y

# Increase NUM_IRQS to support EIID range used by AIA
CONFIG_NUM_IRQS=256
```

## boards/snps/nsim/arc_v/nsim_arc_v_rmx100_defconfig
```kconfig
# Copyright (c) 2024 Synopsys, Inc.
# SPDX-License-Identifier: Apache-2.0

CONFIG_XIP=n
CONFIG_CONSOLE=y
CONFIG_SERIAL=y
CONFIG_UART_CONSOLE=y
CONFIG_BUILD_OUTPUT_HEX=y
CONFIG_INCLUDE_RESET_VECTOR=y
CONFIG_LOG=y

# nSIM standalone mode has no PLIC/APLIC model, so UART interrupts never
# reach the CPU. Use polling mode for the shell UART backend instead.
CONFIG_SHELL_BACKEND_SERIAL_INTERRUPT_DRIVEN=n

# TEMPORARILY ENABLED FOR TESTING - investigate using Zephyr's picolibc
# integration (lib/libc/picolibc/) with MWDT's toolchain-provided picolibc,
# instead of the arcmwdt libc shim. Revert after experiment.
CONFIG_PICOLIBC=y
CONFIG_PICOLIBC_USE_TOOLCHAIN=y
```

## cmake/toolchain/arcmwdt/Kconfig.defconfig
```kconfig
# Copyright (c) 2024 Synopsys
# SPDX-License-Identifier: Apache-2.0

# TEMPORARILY ENABLED FOR TESTING - revert after experiment
config PICOLIBC_SUPPORTED
	default y
```

## modules/Kconfig.embarc-mli
```kconfig
# Copyright (c) 2019 Synopsys
# SPDX-License-Identifier: Apache-2.0

config EMBARC_MLI
	bool "embarc Machine Learning Library Support"
	depends on CPU_ARCV2
	help
	  This options enables the embarc Machine Learning Library.

if EMBARC_MLI


choice
	prompt "Select target platform for embarc mli library"
	default EMBARC_MLI_DSP_XY

config EMBARC_MLI_DSP_XY
	bool "for targets with XY mem and DSP"
	help
	  Set if embarc mli library is for targets with XY mem and DSP,
	  e.g., EM9D, EM11D.

config EMBARC_MLI_DSP_WIDE
	bool "for targets with wide DSP"
	help
	  Set if embarc mli library is for targets with wide DSP,
	  e.g., HS45D, HS47D.

config EMBARC_MLI_DSP
	bool "for targets with DSP only"
	help
	  Set if embarc mli library is for targets with DSP only,
	  e.g., EM5D, EM7D

endchoice

config EMBARC_MLI_HW_TCF_FILE
	string "Target tcf file to build embarc mli library"
	default "../../hw/em9d.tcf"
	help
	   The target tcf file to build embarc mli library. For details
	   please refere embarc mli's documentation

endif # EMBARC_CLI
```

## samples/net/sockets/http_get/boards/emsk_esp8266.conf
```kconfig
# Networking Config:
CONFIG_NETWORKING=y
CONFIG_NET_IPV4=y
CONFIG_NET_IPV6=n
CONFIG_NET_TCP=y
CONFIG_NET_SOCKETS_POSIX_NAMES=y

# Enable ESP8266
CONFIG_WIFI=y
CONFIG_WIFI_ESP8266=y

# Enable Secure Socket Offload
CONFIG_NET_SOCKETS_SOCKOPT_TLS=n
CONFIG_TLS_CREDENTIAL_FILENAMES=n

# Disable unneeded settings from the base prj.conf:
CONFIG_DNS_RESOLVER=y
CONFIG_DNS_SERVER_IP_ADDRESSES=y
CONFIG_DNS_SERVER1="114.114.114.114"
CONFIG_TEST_RANDOM_GENERATOR=y
CONFIG_NET_CONFIG_SETTINGS=n
CONFIG_NET_CONFIG_MY_IPV4_ADDR=""
CONFIG_NET_CONFIG_PEER_IPV4_ADDR=""

# Debugging
CONFIG_NET_LOG=y
CONFIG_WIFI_LOG_LEVEL_ERR=y
CONFIG_DEBUG=y
CONFIG_ASSERT=y
```

## soc/arc/archs-qemu/Kconfig
```kconfig
#
# Copyright (c) 2018 Synopsys, Inc. All rights reserved.
#
# SPDX-License-Identifier: Apache-2.0
#

if SOC_ARCHS_QEMU

choice
prompt "ARC HS Core Selection"
default SOC_ARCHS_QEMU_V2


config SOC_ARCHS_QEMU_V2
	bool "Synopsys ARC HS v2 of QEmu"
	select CPU_HAS_MPU

endchoice

endif #SOC_ARCHS_QEMU
```

## soc/arc/archs-qemu/Kconfig.defconfig
```kconfig
if SOC_ARCHS_QEMU

config SOC
	string
	default "archs-qemu"

config SYS_CLOCK_HW_CYCLES_PER_SEC
	int
	default 10000000

config UART_CONSOLE_ON_DEV_NAME
	string
	default "UART_0"

config ARC_MPU_VER
	default 2

config RGF_NUM_BANKS
	default 1

config ARC_FIRQ
	default n

config NUM_IRQ_PRIO_LEVELS
	default 4

endif
```

## soc/arc/snps_emwh/Kconfig.defconfig
```kconfig
#
# Copyright (c) 2019 Synopsys, Inc. All rights reserved.
#
# SPDX-License-Identifier: Apache-2.0
#

if SOC_EMWH

config SOC
	string
	default "snps_emwh"

config CPU_EM4_FPUS
	def_bool y

config NUM_IRQ_PRIO_LEVELS
	# This processor supports 4 priority levels:
	# 0 for Fast Interrupts (FIRQs) and 1-3 for Regular Interrupts (IRQs).
	default 4

config NUM_IRQS
	# must be > the highest interrupt number used
	default 38

config RGF_NUM_BANKS
	default 2

config SYS_CLOCK_HW_CYCLES_PER_SEC
	default 36363636

config HARVARD
	default y


endif
```

## soc/arc/snps_emwh/Kconfig.soc
```kconfig
#
# Copyright (c) 2019 Synopsys, Inc. All rights reserved.
#
# SPDX-License-Identifier: Apache-2.0
#

config SOC_EMWH
	bool "Synopsys ARC EM Wuhan SoC"
	select HAS_I2C_DW if I2C
	select HAS_SPI_DW if SPI
```

## soc/arc/snps_nsim/Kconfig.defconfig.hs6x_smp
```kconfig
# Copyright (c) 2021 Synopsys, Inc.
# SPDX-License-Identifier: Apache-2.0

if SOC_NSIM_HS6X_SMP

config CPU_HS6X
	default y

config NUM_IRQ_PRIO_LEVELS
	# This processor supports 16 priority levels:
	default 2

config NUM_IRQS
	# must be > the highest interrupt number used
	default 30

config SYS_CLOCK_HW_CYCLES_PER_SEC
	default $(dt_node_int_prop_int,$(dt_nodelabel_path,uart0),clock-frequency)

config CACHE_MANAGEMENT
	default y

config ARC_CONNECT
	default y

config MP_NUM_CPUS
	default 2

endif # SOC_NSIM_HS6X_SMP
```

## soc/qemu/virt_riscv/qemu_virt_riscv32_aia/Kconfig.soc
```kconfig
# Copyright (c) 2024 Antmicro <www.antmicro.com>
# SPDX-License-Identifier: Apache-2.0

config SOC_QEMU_VIRT_RISCV32_AIA
    bool
    select RISCV
    select RISCV_PRIVILEGED
    select RISCV_HAS_AIA
    select INCLUDE_RESET_VECTOR
    select RISCV_ISA_EXT_M
    select RISCV_ISA_EXT_A
    select RISCV_ISA_EXT_C
    select RISCV_SOC_HAS_GP_RELATIVE_ADDRESSING
    imply XIP

config SOC
    default "qemu_virt_riscv32_aia" if SOC_QEMU_VIRT_RISCV32_AIA
```
